## configs/fa210_ubi_min_defconfig
```kconfig
BR2_arm=y
BR2_cortex_a8=y
BR2_ARM_FPU_NEON=y
BR2_KERNEL_HEADERS_VERSION=y
BR2_DEFAULT_KERNEL_VERSION="3.0.8"
BR2_PACKAGE_HOST_LINUX_HEADERS_CUSTOM_3_0=y
BR2_TOOLCHAIN_BUILDROOT_EGLIBC=y
BR2_GCC_VERSION_4_5_X=y
BR2_TOOLCHAIN_BUILDROOT_CXX=y
BR2_TARGET_GENERIC_PASSWD_SHA256=y
BR2_ROOTFS_DEVICE_CREATION_DYNAMIC_MDEV=y
BR2_TARGET_GENERIC_GETTY_PORT="ttySAC0"
BR2_ROOTFS_POST_BUILD_SCRIPT="$(BR2_EXTERNAL)/General/scripts/pre_image.sh"
BR2_ROOTFS_POST_IMAGE_SCRIPT="$(BR2_EXTERNAL)/210/scripts/post_image.sh"
BR2_ROOTFS_POST_SCRIPT_ARGS="ubi"
BR2_LINUX_KERNEL=y
BR2_LINUX_KERNEL_CUSTOM_GIT=y
BR2_LINUX_KERNEL_CUSTOM_REPO_URL="https://github.com/MechCalc/FriendlyARM_210_Kernel.git"
BR2_LINUX_KERNEL_CUSTOM_REPO_VERSION="linux-3.0"
BR2_LINUX_KERNEL_USE_CUSTOM_CONFIG=y
BR2_LINUX_KERNEL_CUSTOM_CONFIG_FILE="$(BR2_EXTERNAL)/210/configs/kernel_ubi_min.config"
BR2_LINUX_KERNEL_ZIMAGE=y
BR2_PACKAGE_BUSYBOX_CONFIG="$(TOPDIR)/package/busybox/busybox-1.22.x.config"
BR2_PACKAGE_OPENSSL=y
```

## configs/fa2451_yaffs2_min_defconfig
```kconfig
BR2_arm=y
BR2_KERNEL_HEADERS_VERSION=y
BR2_DEFAULT_KERNEL_VERSION="3.6"
BR2_PACKAGE_HOST_LINUX_HEADERS_CUSTOM_3_6=y
BR2_TOOLCHAIN_BUILDROOT_EGLIBC=y
BR2_GCC_VERSION_4_4_X=y
BR2_TOOLCHAIN_BUILDROOT_CXX=y
BR2_TARGET_GENERIC_PASSWD_SHA256=y
BR2_ROOTFS_DEVICE_CREATION_DYNAMIC_MDEV=y
BR2_TARGET_GENERIC_GETTY_PORT="ttySAC0"
BR2_ROOTFS_POST_BUILD_SCRIPT="$(BR2_EXTERNAL)/General/scripts/pre_image.sh"
BR2_ROOTFS_POST_IMAGE_SCRIPT="$(BR2_EXTERNAL)/2451/scripts/post_image.sh"
BR2_ROOTFS_POST_SCRIPT_ARGS="yaffs2"
BR2_LINUX_KERNEL=y
BR2_LINUX_KERNEL_CUSTOM_GIT=y
BR2_LINUX_KERNEL_CUSTOM_REPO_URL="git@github.com:MechCalc/FriendlyARM_2451_Kernel.git"
BR2_LINUX_KERNEL_CUSTOM_REPO_VERSION="master"
BR2_LINUX_KERNEL_USE_CUSTOM_CONFIG=y
BR2_LINUX_KERNEL_CUSTOM_CONFIG_FILE="$(BR2_EXTERNAL)/2451/configs/kernel_yaffs2_min.config"
BR2_LINUX_KERNEL_ZIMAGE=y
```

## configs/fa4412_min_defconfig
```kconfig
BR2_arm=y
BR2_cortex_a9=y
BR2_ARM_ENABLE_NEON=y
BR2_ARM_FPU_NEON=y
BR2_KERNEL_HEADERS_VERSION=y
BR2_DEFAULT_KERNEL_VERSION="3.5"
BR2_PACKAGE_HOST_LINUX_HEADERS_CUSTOM_3_5=y
BR2_TOOLCHAIN_BUILDROOT_EGLIBC=y
BR2_GCC_VERSION_4_5_X=y
BR2_TOOLCHAIN_BUILDROOT_CXX=y
BR2_TARGET_GENERIC_PASSWD_SHA256=y
BR2_ROOTFS_DEVICE_CREATION_DYNAMIC_MDEV=y
BR2_TARGET_GENERIC_GETTY_PORT="ttySAC0"
BR2_ROOTFS_POST_BUILD_SCRIPT="$(BR2_EXTERNAL)/General/scripts/pre_image.sh"
BR2_ROOTFS_POST_IMAGE_SCRIPT="$(BR2_EXTERNAL)/4412/scripts/post_image.sh"
BR2_LINUX_KERNEL=y
BR2_LINUX_KERNEL_CUSTOM_GIT=y
BR2_LINUX_KERNEL_CUSTOM_REPO_URL="git@github.com:MechCalc/FriendlyARM_4412_Kernel.git"
BR2_LINUX_KERNEL_CUSTOM_REPO_VERSION="master"
BR2_LINUX_KERNEL_USE_CUSTOM_CONFIG=y
BR2_LINUX_KERNEL_CUSTOM_CONFIG_FILE="$(BR2_EXTERNAL)/4412/configs/kernel_ext4_min.config"
BR2_LINUX_KERNEL_ZIMAGE=y
```
